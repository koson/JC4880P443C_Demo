## main/Kconfig.projbuild
```kconfig
menu "Dashboard WiFi Configuration"

    config ESP_WIFI_SSID
        string "WiFi SSID"
        default "myssid"
        help
            SSID (network name) to connect to.

    config ESP_WIFI_PASSWORD
        string "WiFi Password"
        default "mypassword"
        help
            WiFi password (WPA or WPA2).

    choice ESP_WIFI_SAE_MODE
        prompt "WPA3 SAE mode selection"
        default ESP_STATION_EXAMPLE_WPA3_SAE_PWE_BOTH
        help
            Select mode for SAE as Hunt and Peck, H2E or both.
        config ESP_STATION_EXAMPLE_WPA3_SAE_PWE_HUNT_AND_PECK
            bool "HUNT AND PECK"
        config ESP_STATION_EXAMPLE_WPA3_SAE_PWE_HASH_TO_ELEMENT
            bool "H2E"
            depends on ESP_WIFI_ENABLE_SAE_H2E
        config ESP_STATION_EXAMPLE_WPA3_SAE_PWE_BOTH
            bool "BOTH"
            depends on ESP_WIFI_ENABLE_SAE_H2E
    endchoice

    config ESP_WIFI_PW_ID
        string "PASSWORD IDENTIFIER"
        depends on ESP_STATION_EXAMPLE_WPA3_SAE_PWE_HASH_TO_ELEMENT || \
                   ESP_STATION_EXAMPLE_WPA3_SAE_PWE_BOTH
        default ""
        help
            Password identifier for SAE H2E.

    config ESP_MAXIMUM_RETRY
        int "Maximum retry count"
        default 5
        help
            How many times to retry before giving up and showing
            "No WiFi" on the dashboard status bar.

    choice ESP_WIFI_SCAN_AUTH_MODE_THRESHOLD
        prompt "WiFi scan auth mode threshold"
        default ESP_WIFI_AUTH_WPA2_PSK
        help
            Weakest auth mode to accept during scan.
        config ESP_WIFI_AUTH_OPEN
            bool "OPEN"
        config ESP_WIFI_AUTH_WEP
            bool "WEP"
        config ESP_WIFI_AUTH_WPA_PSK
            bool "WPA PSK"
        config ESP_WIFI_AUTH_WPA2_PSK
            bool "WPA2 PSK"
        config ESP_WIFI_AUTH_WPA_WPA2_PSK
            bool "WPA/WPA2 PSK"
        config ESP_WIFI_AUTH_WPA3_PSK
            bool "WPA3 PSK"
        config ESP_WIFI_AUTH_WPA2_WPA3_PSK
            bool "WPA2/WPA3 PSK"
        config ESP_WIFI_AUTH_WAPI_PSK
            bool "WAPI PSK"
    endchoice

endmenu

menu "Dashboard MQTT Configuration"

    config MQTT_BROKER_URI
        string "MQTT broker URI"
        default "mqtt://192.168.1.1"
        help
            Full URI of your local MQTT broker.
            Examples:
              mqtt://192.168.1.10        (default port 1883, no auth)
              mqtt://192.168.1.10:1884   (custom port)
            No username/password — broker must allow anonymous access.

    config MQTT_CLIENT_ID
        string "MQTT client ID"
        default "esp32p4-dashboard"
        help
            Unique client identifier sent to the broker on connect.
            Must be unique across all clients on your broker.

    config MQTT_KEEPALIVE_SEC
        int "MQTT keepalive interval (seconds)"
        default 30
        help
            How often the client pings the broker to keep the
            connection alive. 30 s is a safe default for a local LAN.

endmenu
```
